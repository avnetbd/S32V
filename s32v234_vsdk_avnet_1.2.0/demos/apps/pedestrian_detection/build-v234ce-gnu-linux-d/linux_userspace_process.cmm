GLOBAL &term_com_port &ip_address &file_elf &dir_elf &dir_sdk &dir_vmlinux

&term_com_port="COM4"
&ip_address="10.29.204.125"
;&ip_address="169.254.205.102"
&file_elf="gdc_pd.elf"
&dir_elf=os.file.path(&(elf_file))
&dir_sdk="../../../.."
&dir_vmlinux="C:/Tools/Trace32/vmlinux"

b.d /ALL

OS.HIDDEN scp -o StrictHostKeyChecking=no ../../../data/apps/pedestrian_detection/gdc_pd.ini root@&(ip_address):/home/root/data/apps/pedestrian_detection

DO &(dir_sdk)/script/cmm/linux_userspace_process.cmm

d.l

;symbol.SourcePATH.translate "/home/s32v" "V:"
symbol.sourcepath.translate "/home/s32v/" "V:/"

b.s __do_user_fault

;b.s main\6
;b.s main\25

;b.s GdcPd_Helper::GetResizeFrameSizes

;v.chain (*(gsp_Allocator[1])).chunk_sentinel (*(gsp_Allocator[1])).chunk_sentinel.pNext
;v.v gs_num_allocations[0..3]

go


