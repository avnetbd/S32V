GLOBAL &term_com_port &ip_address &file_elf &dir_elf &dir_sdk &dir_vmlinux

&term_com_port="COM4"
&ip_address="10.29.204.125"
;&ip_address="169.254.205.102"
&file_elf="gdc_ft.elf"
&dir_elf=os.file.path(&(elf_file))
&dir_sdk="../../../.."
&dir_vmlinux="C:/Tools/Trace32/vmlinux"

b.d /ALL

OS.HIDDEN scp -o StrictHostKeyChecking=no ../../../data/apps/feature_tracking/gdc_ft.ini root@&(ip_address):/home/root/data/apps/feature_tracking

DO &(dir_sdk)/script/cmm/linux_userspace_process.cmm

d.l

symbol.sourcepath.translate "/home/s32v/" "V:/"

b.s __do_user_fault


go main

ENDDO
